## block/Kconfig.iosched
```kconfig
# SPDX-License-Identifier: GPL-2.0
menu "IO Schedulers"

config MQ_IOSCHED_DEADLINE
	tristate "MQ deadline I/O scheduler"
	default y
	help
	  MQ version of the deadline IO scheduler.

config MQ_IOSCHED_KYBER
	tristate "Kyber I/O scheduler"
	default y
	help
	  The Kyber I/O scheduler is a low-overhead scheduler suitable for
	  multiqueue and other fast devices. Given target latencies for reads and
	  synchronous writes, it will self-tune queue depths to achieve that
	  goal.


config MQ_IOSCHED_ADIOS
	tristate "Adaptive Deadline I/O scheduler"
	default m
	help
	  The Adaptive Deadline I/O Scheduler (ADIOS) is a multi-queue I/O
	  scheduler with learning-based adaptive latency control.

config MQ_IOSCHED_DEFAULT_ADIOS
	bool "Enable ADIOS I/O scheduler as default MQ I/O scheduler"
	depends on MQ_IOSCHED_ADIOS=y
	default n
	help
	  Enable the ADIOS I/O scheduler as the default scheduler for MQ I/O.

config MQ_IOSCHED_ADIOS_ENFORCE_DISK
	string "Disk name the boot-time ADIOS enforcer is restricted to (empty = all disks)"
	depends on MQ_IOSCHED_DEFAULT_ADIOS
	default ""
	help
	  REVIEW FIX: the boot-time enforcer (genhd.c, saga_adios_enforce_fn)
	  used to call elv_iosched_store(q, "adios", 5) on every disk in the
	  system (block_class, no filter beyond nonzero capacity) to win a
	  race against vendor init possibly setting a different scheduler
	  after boot. That's broader than it needs to be -- it can briefly
	  perturb unrelated queues (boot/vendor/cache/other LUs) during the
	  most I/O-sensitive part of boot, repeated 5 times over ~100s.
	
	  Set this to the exact disk_name (as shown in /sys/block/<name>,
	  e.g. "sda" or "sdc" -- this can differ from what you'd guess, and
	  can differ between devices/firmware even on the same phone model)
	  of the disk you actually care about (typically the one backing
	  /data) to restrict enforcement to just that device. Leave empty to
	  keep the old, unrestricted behavior.

config IOSCHED_BFQ
	tristate "BFQ I/O scheduler"
	select BLK_ICQ
	help
	BFQ I/O scheduler for BLK-MQ. BFQ distributes the bandwidth of
	of the device among all processes according to their weights,
	regardless of the device parameters and with any workload. It
	also guarantees a low latency to interactive and soft
	real-time applications.  Details in
	Documentation/block/bfq-iosched.rst

config BFQ_GROUP_IOSCHED
       bool "BFQ hierarchical scheduling support"
       depends on IOSCHED_BFQ && BLK_CGROUP
       select BLK_CGROUP_RWSTAT
	help

       Enable hierarchical scheduling in BFQ, using the blkio
       (cgroups-v1) or io (cgroups-v2) controller.

config BFQ_CGROUP_DEBUG
	bool "BFQ IO controller debugging"
	depends on BFQ_GROUP_IOSCHED
	help
	Enable some debugging help. Currently it exports additional stat
	files in a cgroup which can be useful for debugging.

endmenu
```
